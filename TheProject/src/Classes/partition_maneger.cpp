#include "partition_maneger.h"
#include "MyOS.h"
#include "./Classes/MainMenuV2.h"

#include "esp_heap_caps.h"
#include "esp_flash.h"
#include "esp_log.h"
#include "esp_system.h"
#include "esp_spi_flash.h"
#include "esp32s3/rom/spi_flash.h"
#include "esp_partition.h"
bool dfsfes=false;
// #define PARTITION_TYPE gamestation
//  Standard Flash sector size (4KB)
#define PARTITION_SIZE 4096
// Fixed address where ESP32 expects to find the partition table
static const uint32_t PARTITION_ADDR = 0x00008000;
// Calculate sector number based on address
static const uint32_t PARTITION_SECTOR = PARTITION_ADDR / 0x1000;
// Target SPIFFS size to verify "Launcher" mode (1MB)
static const size_t LAUNCHER_SPIFFS_SIZE = 1 * 1024 * 1024;
/**
 * Byte array representing the new "Game Station" partition table.
 * Contains definitions for nvs, app0, app1, spiffs, and coredump.
 * This is the binary output generated by the ESP-IDF Partition Tool.
 */

/* const uint8_t fromBIN[256] = {
    0xAA, 0x50, 0x01, 0x02, 0x00, 0x90, 0x00, 0x00, 0x00, 0x60, 0x00, 0x00, 0x6E, 0x76, 0x73, 0x00,
    0x00, 0x00, 0x00, 0x00, 0x00, 0x00, 0x00, 0x00, 0x00, 0x00, 0x00, 0x00, 0x00, 0x00, 0x00, 0x00,
    0xAA, 0x50, 0x00, 0x20, 0x00, 0x00, 0x01, 0x00, 0x00, 0x00, 0x16, 0x00, 0x61, 0x70, 0x70, 0x30,
    0x00, 0x00, 0x00, 0x00, 0x00, 0x00, 0x00, 0x00, 0x00, 0x00, 0x00, 0x00, 0x00, 0x00, 0x00, 0x00,
    0xAA, 0x50, 0x00, 0x10, 0x00, 0x00, 0x17, 0x00, 0x00, 0x00, 0x20, 0x00, 0x61, 0x70, 0x70, 0x31,
    0x00, 0x00, 0x00, 0x00, 0x00, 0x00, 0x00, 0x00, 0x00, 0x00, 0x00, 0x00, 0x00, 0x00, 0x00, 0x00,
    0xAA, 0x50, 0x00, 0x11, 0x00, 0x00, 0x37, 0x00, 0x00, 0x00, 0x20, 0x00, 0x61, 0x70, 0x70, 0x32,
    0x00, 0x00, 0x00, 0x00, 0x00, 0x00, 0x00, 0x00, 0x00, 0x00, 0x00, 0x00, 0x00, 0x00, 0x00, 0x00,
    0xAA, 0x50, 0x01, 0x00, 0x00, 0x00, 0x57, 0x00, 0x00, 0x20, 0x00, 0x00, 0x6F, 0x74, 0x61, 0x64,
    0x61, 0x74, 0x61, 0x00, 0x00, 0x00, 0x00, 0x00, 0x00, 0x00, 0x00, 0x00, 0x00, 0x00, 0x00, 0x00,
    0xAA, 0x50, 0x01, 0x82, 0x00, 0x20, 0x57, 0x00, 0x00, 0xE0, 0x27, 0x00, 0x73, 0x70, 0x69, 0x66,
    0x66, 0x73, 0x00, 0x00, 0x00, 0x00, 0x00, 0x00, 0x00, 0x00, 0x00, 0x00, 0x00, 0x00, 0x00, 0x00,
    0xAA, 0x50, 0x01, 0x03, 0x00, 0x00, 0x7F, 0x00, 0x00, 0x00, 0x01, 0x00, 0x63, 0x6F, 0x72, 0x65,
    0x64, 0x75, 0x6D, 0x70, 0x00, 0x00, 0x00, 0x00, 0x00, 0x00, 0x00, 0x00, 0x00, 0x00, 0x00, 0x00,
    0xEB, 0xEB, 0xFF, 0xFF, 0xFF, 0xFF, 0xFF, 0xFF, 0xFF, 0xFF, 0xFF, 0xFF, 0xFF, 0xFF, 0xFF, 0xFF,
    0x35, 0x35, 0xBA, 0x5B, 0xC7, 0x8F, 0x0C, 0x19, 0x5B, 0x68, 0xD0, 0xF6, 0xF4, 0x01, 0xEC, 0x46};
 */
const uint8_t fromBINv2[256] = {
    0xAA, 0x50, 0x01, 0x02, 0x00, 0x90, 0x00, 0x00, 0x00, 0x60, 0x00, 0x00, 0x6E, 0x76, 0x73, 0x00,
    0x00, 0x00, 0x00, 0x00, 0x00, 0x00, 0x00, 0x00, 0x00, 0x00, 0x00, 0x00, 0x00, 0x00, 0x00, 0x00,
    0xAA, 0x50, 0x00, 0x20, 0x00, 0x00, 0x01, 0x00, 0x00, 0x00, 0x16, 0x00, 0x61, 0x70, 0x70, 0x30,
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    0x75, 0x46, 0x74, 0xEF, 0x07, 0x49, 0x63, 0x87, 0x0F, 0xFF, 0xFD, 0x88, 0x74, 0x4D, 0x87, 0xF6};
static bool write_partition()
{
    os.ShowOnScreenMessege("Preparing partition buffer...\n",100);

    uint32_t *buf = (uint32_t *)heap_caps_malloc(
        PARTITION_SIZE,
        MALLOC_CAP_INTERNAL | MALLOC_CAP_32BIT);
    if (!buf)
    {
        os.ShowOnScreenMessege("Failed to allocate partition buffer\n");
        return false;
    }

    uint8_t *buf8 = reinterpret_cast<uint8_t *>(buf);
    memset(buf8, 0xFF, PARTITION_SIZE);
    memcpy(buf8, fromBINv2, sizeof(fromBINv2));

    os.ShowOnScreenMessege("Erasing old partition...\n",
                           (unsigned)PARTITION_SECTOR);

    int rc = esp_rom_spiflash_erase_sector(PARTITION_SECTOR);
    if (rc != 0)
    {
        os.ShowOnScreenMessege("esp_rom_spiflash_erase_sector failed");
        heap_caps_free(buf);
        return false;
    }

    os.ShowOnScreenMessege("Writing partition...\n",100);

    rc = esp_rom_spiflash_write(PARTITION_ADDR, buf, PARTITION_SIZE);
    heap_caps_free(buf);

    if (rc != 0)
    {
        os.ShowOnScreenMessege("esp_rom_spiflash_write failed\n");
        return false;
    }

    os.ShowOnScreenMessege("Write done.\n",100);
    return true;
}

/**
 * Guard function: Checks if the device is currently in "Launcher" configuration.
 * Validates this by checking the size of the existing SPIFFS partition.
 */

/**
 * Main function to execute the "Flash Hack"
 */
bool flashPartition()
{
    if (!os.AskSomthing("Are you sure AdvanceOS was installed through the launcher? If not, the Cardputer may crash, and you will need to reinstall the firmware using a computer"))
    {
        return false;
    }
    // Ecriture
    if (!write_partition())
    {
        os.ShowOnScreenMessege("partition write FAILED\n");
        return false;
    }

    os.ShowOnScreenMessege("YAY Partition write OK, verifying content...\n",100);

    uint8_t verifyBuf[sizeof(fromBINv2)];
    esp_err_t err = spi_flash_read(PARTITION_ADDR, verifyBuf, sizeof(verifyBuf));
    if (err != ESP_OK)
    {
        os.ShowOnScreenMessege("spi_flash_read failed during verification");
        return false;
    }

    // Verif
    for (size_t i = 0; i < sizeof(fromBINv2); ++i)
    {
        if (verifyBuf[i] != fromBINv2[i])
        {
            os.ShowOnScreenMessege("Verification mismatch at byte %u: flash=0x%02X expected=0x%02X\n",
                                   (unsigned)i);
            os.ShowOnScreenMessege("Verification FAILED — partition table NOT valid.\n");
            return false;
        }
    }

    os.ShowOnScreenMessege("partition verified successfully.\n",100);
    return true;
}

void partition_maneger::Begin()
{

    if (mainOS->ChangePartitionLayoutToAdvanceOSinLauncher)
    {

        if (flashPartition())
        {
            mainOS->ShowOnScreenMessege("Success! Rebooting in 2 seconds...", 10);
            delay(2000);
            esp_restart(); // Must restart device so Bootloader reads the new table
        }
        else
        {
            mainOS->ShowOnScreenMessege("Partition update failed.", 3000);
        }
    }
    _totalFlash = 0;
    _partitions.clear();

    // Initial scan to collect partition data
    esp_partition_iterator_t it = esp_partition_find(ESP_PARTITION_TYPE_ANY, ESP_PARTITION_SUBTYPE_ANY, NULL);
    int i = 0;

    while (it != NULL)
    {
        const esp_partition_t *p = esp_partition_get(it);

        PartitionInfo info;
        strncpy(info.label, p->label, 16);
        info.label[16] = '\0';
        info.size = p->size;
        info.address = p->address;
        info.color = getPartitionColor(i);

        _partitions.push_back(info);
        _totalFlash += p->size;

        i++;
        it = esp_partition_next(it);
    }
    esp_partition_iterator_release(it);
}

void partition_maneger::Loop()
{
    if (mainOS->screenOff)
    {
        return;
    }
    if (mainOS->NewKey.ifKeyJustPress('`'))
    {
        mainOS->ChangeMenu(new MainMenuV2(mainOS));
    }

    if (M5Cardputer.Keyboard.isKeyPressed('9'))
    {
        if (mainOS->isInBruceLauncherNormalLayout())
        {
            mainOS->ShowOnScreenMessege("In Bruce Launcher", 1000);
        }
        else
        {
            mainOS->ShowOnScreenMessege("Not In Bruce Launcher (Or not in default partition scheme)", 1000);
        }
    }
    if (M5Cardputer.Keyboard.isKeyPressed('1'))
    {
        if (flashPartition())
        {
            mainOS->ShowOnScreenMessege("Success! Rebooting in 3 seconds...", 100);
            delay(3000);
            esp_restart(); // Must restart device so Bootloader reads the new table
        }
        else
        {
            mainOS->ShowOnScreenMessege("Partition update failed. Check logs.", 3000);
        }
    }

    Draw();
}

void partition_maneger::Draw()
{
    // Create Sprite
    mainOS->sprite.createSprite(240, 135 - TopOffset);
    mainOS->sprite.fillSprite(BLACK);

    int sw = 220;
    int barH = 12;                     // Thinner bar to make room for text
    int barY = (135 - TopOffset) - 18; // Positioned lower at the bottom
    int currentX = 10;

    int legendX = 5;
    int legendY = 18;
    int lineHeight = 11; // Slightly tighter line spacing

    mainOS->sprite.setTextSize(1);
    mainOS->sprite.setTextColor(WHITE);
    mainOS->sprite.drawString("Flash Map (Name | Size | Address)", 5, 4);

    for (int i = 0; i < _partitions.size(); i++)
    {
        PartitionInfo &p = _partitions[i];

        // --- Draw the Bar at the bottom ---
        int pWidth = (p.size * sw) / _totalFlash;
        if (pWidth < 1)
            pWidth = 1;

        mainOS->sprite.fillRect(currentX, barY, pWidth, barH, p.color);
        mainOS->sprite.drawRect(currentX, barY, pWidth, barH, DARKGREY);

        // --- Draw Partition Legend ---
        // Split into 2 columns if there are more than 9 partitions
        int col = (i >= 9) ? 125 : 0;
        int row = (i >= 9) ? i - 9 : i;
        int curY = legendY + (row * lineHeight);

        // Color box indicator
        mainOS->sprite.fillRect(legendX + col, curY + 2, 6, 6, p.color);

        mainOS->sprite.setTextColor(p.color);
        mainOS->sprite.setCursor(legendX + col + 10, curY);

        // Print Name, Size, and Hex Address
        // %06X provides a 6-character hex format (ideal for 16MB Cardputer flash)
        if (p.size >= 1024 * 1024)
        {
            mainOS->sprite.printf("%s %.1fM @%06X", p.label, (float)p.size / 1048576.0, p.address);
        }
        else
        {
            mainOS->sprite.printf("%s %dK @%06X", p.label, p.size / 1024, p.address);
        }

        currentX += pWidth;
    }

    mainOS->sprite.pushSprite(0, 0);
    mainOS->sprite.deleteSprite();
}

uint16_t partition_maneger::getPartitionColor(int index)
{
    uint16_t palette[] = {TFT_BLUE, TFT_GREEN, TFT_RED, TFT_YELLOW, TFT_MAGENTA, TFT_CYAN, TFT_ORANGE, TFT_PURPLE};
    return palette[index % 8];
}

void partition_maneger::SetAdvanceOS_partition()
{
    // Implementation for setting Advanced OS partition
}